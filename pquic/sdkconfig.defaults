## tunnel-app/sdkconfig.defaults
```kconfig
# Cloudflare Tunnel - sdkconfig defaults
# Based on pquic/examples/pico-mqtt/sdkconfig.defaults

# Partition table
CONFIG_PARTITION_TABLE_SINGLE_APP_LARGE=y

# Disable ISR event posting (linux compat FreeRTOS doesn't support it)
CONFIG_ESP_EVENT_POST_FROM_ISR=n

# System
CONFIG_ESP_SYSTEM_PANIC_PRINT_HALT=y
CONFIG_ESP_MAIN_TASK_STACK_SIZE=16384
CONFIG_PTHREAD_DEFAULT_CORE_NO_AFFINITY=y

# mbedTLS: enable ciphers required by picoquic
CONFIG_MBEDTLS_CHACHA20_C=y
CONFIG_MBEDTLS_HKDF_C=y

# mbedTLS: TLS 1.3 support for QUIC
CONFIG_MBEDTLS_SSL_PROTO_TLS1_3=y
CONFIG_MBEDTLS_SSL_TLS1_3_COMPATIBILITY_MODE=y
CONFIG_MBEDTLS_CLIENT_SSL_SESSION_TICKETS=y
CONFIG_MBEDTLS_SSL_KEEP_PEER_CERTIFICATE=y
```
